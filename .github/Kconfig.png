## main/Kconfig.projbuild
```kconfig
menu "Network Configuration"
    config ESP_WIFI_SSID
        string "WiFi SSID"

    config ESP_WIFI_PASSWORD
        string "WiFi Password"

    config MDNS_ENABLE
        bool "Enable mDNS"
        default y

    config MDNS_HOST_NAME
        string "mDNS Host Name"
        default "watering"
        help
            Web Interface can be reached under <mdnshostname>.local
endmenu

menu "ADC Configuration"
    config ADC_POLLING_INTERVALL
        int "ADC polling intervall [ms]"
        default 1000
        help
            Time between reads of the moisture sensor

    config ADC1_GPIO_PIN
        int "ADC1 GPIO Channel PIN"
        default 35
        help
            Channel 0 : Pin 36
            Channel 1 : Pin 37
            Channel 2 : Pin 38
            Channel 3 : Pin 39
            Channel 4 : Pin 32
            Channel 5 : Pin 33
            Channel 6 : Pin 34
            Channel 7 : Pin 35

    config ADC1_GPIO_CHANNEL
        int "ADC1 GPIO Channel"
        default 7
        help
            Channel 0 : Pin 36
            Channel 1 : Pin 37
            Channel 2 : Pin 38
            Channel 3 : Pin 39
            Channel 4 : Pin 32
            Channel 5 : Pin 33
            Channel 6 : Pin 34
            Channel 7 : Pin 35
endmenu

menu "Manual Watering Button"
    config ENABLE_WATERING_BUTTON
        bool "Enable watering button"
        default y
        help 
            Enables button for manual control of watering

    config WATERING_BUTTON_INVERT
        depends on ENABLE_WATERING_BUTTON
        bool "Invert watering button edge behaviour"
        default n
        help 
            Inverts the edge triggers for the manual watering button
            If disabled: Falling edge = PUMP ON/START
                         Rising edge  = PUMP OFF

    choice WATERING_BUTTON_MODE
        depends on ENABLE_WATERING_BUTTON
        prompt "Watering button mode"
        config WATERING_BUTTON_MODE_WHILE_PRESSED
            bool "While pressed"

        config WATERING_BUTTON_MODE_SINGLE
            bool "Predetermined"
        help
            While pressed: Pump is on while button is pressed
            Predetermined: Pump is on for the set time
    endchoice


    config WATER_BUTTON_GPIO_PIN
        depends on ENABLE_WATERING_BUTTON
        int "Manual watering button GPIO PIN"
        default 26
        help
            GPIO PIN number to which the button for manual control of watering is connected to
endmenu

menu "Pump Configuration"
    config MOISTURE_CHECK_INTERVALL
        int "Moisture check intervall [ms]"
        default 1000
        help
            Time between checks of soil moisture, that control whether the pump is started.

    config PUMP_CONTROL_PIN
        int "Pump Control Pin"
        default 27
        help
            GPIO PIN number for the PIN that controls the pump motor.

    config PUMP_CONTROL_INVERT
        bool "Invert Pump Control"
        default n
        help
            When false the pump turns on when the pump control pin is set to high. Setting this inverts the behaviour.

    config DEFAULT_PUMP_ON_TIME
        int "Default pump on time [ms]"
        default 500
        help
            Time in ms for which the pump turns on when command to water is given.
    
    config DEFAULT_WATERING_TRIGGER
        int "Default watering trigger level"
        default 500
        help
            Default analog signal level which causes the pump to begin watering.

    config DEFAULT_REARM_TRIGGER
        int "Default rearm trigger level"
        default 2000
        help
            After crossing this analog signal level the pump will again water when falling under the watering trigger level.

    config WATER_TIME_CONSTANT
        float "Water time constant K"
        default 1.0
        help
            This constant needs to fullfill:
            water_dispensed[mL] = K * pump_on_time[ms]

    config ANALOGUE_MOISTURE_CONSTANT
        float "Analogue moisture constant L"
        default 0.05
        help
            This constant needs to fullfill:
            moisture[%] = L * (ADC_signal_level - A)

    config ANALOGUE_MOISTURE_OFFSET
        float "Analogue moisture offset A"
        default 0
        help
            This constant needs to fullfill:
            moisture[%] = L * (ADC_signal_level - A)
endmenu
```
